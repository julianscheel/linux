// Definitions for RPi DAC
/dts-v1/;
/plugin/;

/ {
	compatible = "brcm,bcm2708";

	fragment@0 {
		target = <&i2s>;
		__overlay__ {
			status = "okay";
		};
	};

	fragment@1 {
		target = <&sound>;
		__overlay__ {
			compatible = "rpi,i2s-slave";
			i2s-controller = <&i2s>;
			status = "okay";
		};
	};
};

